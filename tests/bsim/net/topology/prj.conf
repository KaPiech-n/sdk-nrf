## CMakeLists.txt
```
# SPDX-License-Identifier: Apache-2.0

cmake_minimum_required(VERSION 3.20.0)

find_package(Zephyr REQUIRED HINTS $ENV{ZEPHYR_BASE})
project(topology_bsim_test)

target_sources(app PRIVATE
	src/main.c
	src/test_main.c
)

if(CONFIG_TOPOLOGY_BSIM_ROLE_PINGER)
	target_sources(app PRIVATE src/topology_test.c)
endif()

include(${ZEPHYR_BASE}/samples/net/common/common.cmake)

zephyr_include_directories(
	${BSIM_COMPONENTS_PATH}/libUtilv1/src/
	${BSIM_COMPONENTS_PATH}/libPhyComv1/src/
)
```

## Kconfig
```
# Copyright (c) 2026 Nordic Semiconductor ASA
# SPDX-License-Identifier: Apache-2.0

mainmenu "BabbleSim OpenThread topology test"

choice TOPOLOGY_BSIM_ROLE
	prompt "BabbleSim topology node role"
	default TOPOLOGY_BSIM_ROLE_PINGER

config TOPOLOGY_BSIM_ROLE_PINGER
	bool "pinger (sends ICMP echo requests)"

config TOPOLOGY_BSIM_ROLE_RESPONDER
	bool "responder (ICMP echo replies only)"

endchoice

config TOPOLOGY_BSIM_PING_INTERVAL_MS
	int "Ping interval in milliseconds (pinger role)"
	default 1000
	depends on TOPOLOGY_BSIM_ROLE_PINGER

config TOPOLOGY_BSIM_PASS_THRESHOLD
	int "Minimum ICMP echo replies required to pass (pinger role)"
	default 5
	depends on TOPOLOGY_BSIM_ROLE_PINGER

source "Kconfig.zephyr"
```

## prj.conf
```kconfig
# BabbleSim OpenThread topology / ping test (KRKNWK-22421 experimental PoC)

CONFIG_NETWORKING=y
CONFIG_NET_IPV6=y
CONFIG_NET_IPV4=n
CONFIG_NET_CONNECTION_MANAGER=y
CONFIG_NET_CONFIG_SETTINGS=y
CONFIG_NET_CONFIG_NEED_IPV6=y

CONFIG_MAIN_STACK_SIZE=3072
CONFIG_SYSTEM_WORKQUEUE_STACK_SIZE=2048

CONFIG_LOG=y
CONFIG_PRINTK=y
CONFIG_NET_LOG=y

CONFIG_NET_PKT_RX_COUNT=16
CONFIG_NET_PKT_TX_COUNT=16
CONFIG_NET_BUF_RX_COUNT=32
CONFIG_NET_BUF_TX_COUNT=32

CONFIG_ENTROPY_GENERATOR=y
CONFIG_TEST_RANDOM_GENERATOR=y
```

## overlay-pinger.conf
```kconfig
# Pinger node: fdde:ad00:beef::1 -> fdde:ad00:beef::2

CONFIG_REQUIRES_FULL_LIBC=y
CONFIG_TOPOLOGY_BSIM_ROLE_PINGER=y

CONFIG_NET_TCP=n
CONFIG_NET_IPV6_NBR_CACHE=n
CONFIG_NET_IPV6_MLD=n

CONFIG_NVS=y
CONFIG_NET_L2_OPENTHREAD=y

CONFIG_OPENTHREAD_CHANNEL=26
CONFIG_OPENTHREAD_NETWORKKEY="00:11:22:33:44:55:66:77:88:99:aa:bb:cc:dd:ee:ff"

CONFIG_NET_CONFIG_MY_IPV6_ADDR="fdde:ad00:beef::1"
CONFIG_NET_CONFIG_PEER_IPV6_ADDR="fdde:ad00:beef::2"

CONFIG_OPENTHREAD_LOG_LEVEL_INFO=y
```

## overlay-responder.conf
```kconfig
# Responder node: fdde:ad00:beef::2

CONFIG_REQUIRES_FULL_LIBC=y
CONFIG_TOPOLOGY_BSIM_ROLE_RESPONDER=y

CONFIG_NET_TCP=n
CONFIG_NET_IPV6_NBR_CACHE=n
CONFIG_NET_IPV6_MLD=n

CONFIG_NVS=y
CONFIG_NET_L2_OPENTHREAD=y

CONFIG_OPENTHREAD_CHANNEL=26
CONFIG_OPENTHREAD_NETWORKKEY="00:11:22:33:44:55:66:77:88:99:aa:bb:cc:dd:ee:ff"

CONFIG_NET_CONFIG_MY_IPV6_ADDR="fdde:ad00:beef::2"
CONFIG_NET_CONFIG_PEER_IPV6_ADDR="fdde:ad00:beef::1"

CONFIG_OPENTHREAD_LOG_LEVEL_WARN=y
```

## src/main.c
```c
/*
 * Copyright (c) 2026 Nordic Semiconductor ASA
 *
 * SPDX-License-Identifier: Apache-2.0
 *
 * BabbleSim OpenThread topology smoke test.
 * Experimental PoC for KRKNWK-22421 (compare with Matter native_sim lane).
 */

#include <zephyr/kernel.h>
#include <zephyr/logging/log.h>
#include <zephyr/net/net_if.h>
#include <zephyr/net/net_ip.h>
#include <zephyr/net/icmp.h>
#include <zephyr/net/net_config.h>
#include <zephyr/random/random.h>

#include "net_sample_common.h"

LOG_MODULE_REGISTER(topology_bsim, LOG_LEVEL_INF);

#if defined(CONFIG_TOPOLOGY_BSIM_ROLE_PINGER)
volatile int topology_ping_reply_count;
#endif

#if defined(CONFIG_TOPOLOGY_BSIM_ROLE_PINGER)

static struct net_icmp_ctx icmp_ctx;
static struct k_work_delayable ping_work;
static struct net_sockaddr_in6 peer_addr;
static uint16_t ping_id;
static uint16_t ping_seq;

static enum net_verdict icmp_reply_handler(struct net_icmp_ctx *ctx, struct net_pkt *pkt,
					   struct net_icmp_ip_hdr *ip_hdr,
					   struct net_icmp_hdr *icmp_hdr, void *user_data)
{
	ARG_UNUSED(ctx);
	ARG_UNUSED(pkt);
	ARG_UNUSED(ip_hdr);
	ARG_UNUSED(user_data);

	if (icmp_hdr->type == NET_ICMPV6_ECHO_REPLY) {
		topology_ping_reply_count++;
		LOG_INF("ICMP echo reply #%d", topology_ping_reply_count);
	}

	return NET_OK;
}

static void ping_send(struct k_work *work)
{
	struct net_icmp_ping_params params = {
		.identifier = ping_id,
		.sequence = ping_seq++,
		.data = NULL,
		.data_size = 0,
	};

	if (net_icmp_send_echo_request(&icmp_ctx, NULL, (struct net_sockaddr *)&peer_addr,
					 &params, NULL) < 0) {
		LOG_WRN("ICMP echo request failed");
	}

	k_work_schedule(&ping_work, K_MSEC(CONFIG_TOPOLOGY_BSIM_PING_INTERVAL_MS));
}

static int ping_init(void)
{
	int ret;

	ping_id = (uint16_t)sys_rand32_get();

	ret = net_icmp_init_ctx(&icmp_ctx, NET_AF_INET6, NET_ICMPV6_ECHO_REPLY, 0,
				icmp_reply_handler);
	if (ret < 0) {
		LOG_ERR("net_icmp_init_ctx failed (%d)", ret);
		return ret;
	}

	peer_addr.sin6_family = AF_INET6;
	peer_addr.sin6_port = 0;
	ret = net_addr_pton(AF_INET6, CONFIG_NET_CONFIG_PEER_IPV6_ADDR,
			    &peer_addr.sin6_addr);
	if (ret < 0) {
		LOG_ERR("Invalid peer address");
		return ret;
	}

	k_work_init_delayable(&ping_work, ping_send);
	k_work_schedule(&ping_work, K_SECONDS(5));

	return 0;
}

#endif /* CONFIG_TOPOLOGY_BSIM_ROLE_PINGER */

int main(void)
{
	struct net_if *iface;
	int ret;

	LOG_INF("topology BabbleSim node (%s)",
		IS_ENABLED(CONFIG_TOPOLOGY_BSIM_ROLE_PINGER) ? "pinger" : "responder");

	ret = net_config_init_app(NULL, "topology BabbleSim");
	if (ret < 0) {
		LOG_ERR("net_config_init_app failed (%d)", ret);
		return ret;
	}

	wait_for_network();

	iface = net_if_get_default();
	if (iface != NULL) {
		net_if_up(iface);
	}

#if defined(CONFIG_TOPOLOGY_BSIM_ROLE_PINGER)
	ret = ping_init();
	if (ret < 0) {
		return ret;
	}
#endif

	while (true) {
		k_sleep(K_FOREVER);
	}

	return 0;
}
```

## src/test_main.c
```c
/*
 * Copyright (c) 2026 Nordic Semiconductor ASA
 *
 * SPDX-License-Identifier: Apache-2.0
 */

#include "bstests.h"

#if defined(CONFIG_TOPOLOGY_BSIM_ROLE_PINGER)
extern struct bst_test_list *test_topology_ping_install(struct bst_test_list *tests);
#endif

bst_test_install_t test_installers[] = {
#if defined(CONFIG_TOPOLOGY_BSIM_ROLE_PINGER)
	test_topology_ping_install,
#endif
	NULL
};
```

## src/topology_test.c
```c
/*
 * Copyright (c) 2026 Nordic Semiconductor ASA
 *
 * SPDX-License-Identifier: Apache-2.0
 */

#include "bs_types.h"
#include "bs_tracing.h"
#include "bs_utils.h"
#include "time_machine.h"
#include "bstests.h"

#define WAIT_TIME 35 /* seconds; OT attach on BabbleSim */

extern volatile int topology_ping_reply_count;
extern enum bst_result_t bst_result;

#define FAIL(...)					\
	do {						\
		bst_result = Failed;			\
		bs_trace_error_time_line(__VA_ARGS__);	\
	} while (0)

#define PASS(...)					\
	do {						\
		bst_result = Passed;			\
		bs_trace_info_time(1, __VA_ARGS__);	\
	} while (0)

static void test_topology_ping_init(void)
{
	bst_ticker_set_next_tick_absolute(WAIT_TIME * 1e6);
	bst_result = In_progress;
}

static void test_topology_ping_tick(bs_time_t HW_device_time)
{
	int replies = topology_ping_reply_count;

	bs_trace_info_time(2, "%i ICMP replies received, expected >= %i\n",
			   replies, CONFIG_TOPOLOGY_BSIM_PASS_THRESHOLD);

	if (replies >= CONFIG_TOPOLOGY_BSIM_PASS_THRESHOLD) {
		PASS("topology_ping PASSED\n");
		bs_trace_exit("Done, disconnecting from simulation\n");
	} else {
		FAIL("topology_ping FAILED (only %i replies after %i seconds)\n",
		     replies, WAIT_TIME);
	}
}

static const struct bst_test_instance test_topology_ping[] = {
	{
		.test_id = "topology_ping",
		.test_descr = "Two-node OpenThread BabbleSim topology ping. "
			      "Pinger waits for Thread attach, sends ICMP echo requests to "
			      "a peer on the same network, and checks reply count.",
		.test_pre_init_f = test_topology_ping_init,
		.test_tick_f = test_topology_ping_tick,
	},
	BSTEST_END_MARKER
};

struct bst_test_list *test_topology_ping_install(struct bst_test_list *tests)
{
	tests = bst_add_tests(tests, test_topology_ping);
	return tests;
}
```
